## conf/layer.conf
```bitbake
# We have a conf and classes directory, add to BBPATH
BBPATH .= ":${LAYERDIR}"

# We have recipes-* directories, add to BBFILES
BBFILES += "${LAYERDIR}/recipes-*/*/*.bb \
            ${LAYERDIR}/recipes-*/*/*.bbappend"

BBFILE_COLLECTIONS += "meta-mion-backports"
BBFILE_PATTERN_meta-mion-backports = "^${LAYERDIR}/"
BBFILE_PRIORITY_meta-mion-backports = "6"

LAYERDEPENDS_meta-mion-backports = "core"
LAYERSERIES_COMPAT_meta-mion-backports = "dunfell"

PREFERRED_PROVIDER_libseccomp = "2.5.1"
PREFERRED_PROVIDER_runc-opencontainers = "1.0.0"
PREFERRED_PROVIDER_containerd-opencontainers = "1.4.3"
PREFERRED_PROVIDER_ipset = "7.11"
PREFERRED_PROVIDER_cni = "0.8.0"
```
